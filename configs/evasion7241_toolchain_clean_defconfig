## configs/evasion7241_toolchain_clean_defconfig
```kconfig
BR2_mipsel=y
# BR2_MIPS_SOFT_FLOAT is not set
BR2_HOST_DIR="/opt/toolchain/evasion"
BR2_CCACHE=y
BR2_OPTIMIZE_2=y
BR2_TOOLCHAIN_BUILDROOT_VENDOR="evasion"
BR2_TOOLCHAIN_BUILDROOT_GLIBC=y
BR2_KERNEL_HEADERS_3_4=y
BR2_GLIBC_VERSION_2_18=y
BR2_BINUTILS_VERSION_2_27_X=y
BR2_TOOLCHAIN_BUILDROOT_CXX=y
BR2_PACKAGE_HOST_GDB=y
BR2_TARGET_GENERIC_HOSTNAME="Evasion"
BR2_TARGET_GENERIC_ISSUE="Login to access console"
BR2_TARGET_GENERIC_CABUNDLE=y
BR2_INIT_NONE=y
BR2_ROOTFS_DEVICE_CREATION_DYNAMIC_EUDEV=y
BR2_TARGET_GENERIC_ROOT_PASSWD="root"
BR2_TARGET_GENERIC_GETTY_TERM=""
BR2_TARGET_TZ_INFO=y
BR2_TARGET_LOCALTIME="Europe/Amsterdam"
BR2_ROOTFS_POST_IMAGE_SCRIPT="board/evasion/evasion.sh"
# BR2_PACKAGE_BUSYBOX is not set
```

## configs/explora_bcm7267_wpe_ml_defconfig
```kconfig
BR2_arm=y
BR2_cortex_a15=y
BR2_ARM_FPU_NEON_VFPV4=y
BR2_ARM_INSTRUCTIONS_THUMB2=y
BR2_CCACHE=y
BR2_OPTIMIZE_2=y
BR2_TOOLCHAIN_BUILDROOT_GLIBC=y
BR2_KERNEL_HEADERS_4_9=y
BR2_GCC_VERSION_9_X=y
BR2_TOOLCHAIN_BUILDROOT_CXX=y
BR2_GCC_ENABLE_LTO=y
BR2_PACKAGE_HOST_GDB=y
BR2_ROOTFS_DEVICE_CREATION_DYNAMIC_EUDEV=y
BR2_TARGET_GENERIC_ROOT_PASSWD="root"
BR2_TARGET_GENERIC_GETTY_PORT="ttyS0"
BR2_SYSTEM_DHCP="eth0"
BR2_ROOTFS_POST_BUILD_SCRIPT="board/explora/post-build.sh"
BR2_ROOTFS_POST_IMAGE_SCRIPT="board/explora/explora.sh"
BR2_PACKAGE_GST1_PLUGINS_BASE_PLUGIN_APP=y
BR2_PACKAGE_GST1_PLUGINS_BASE_PLUGIN_VIDEOCONVERT=y
BR2_PACKAGE_GST1_PLUGINS_BASE_PLUGIN_GIO=y
BR2_PACKAGE_GST1_PLUGINS_BASE_PLUGIN_OGG=y
BR2_PACKAGE_GST1_PLUGINS_BASE_PLUGIN_OPUS=y
BR2_PACKAGE_GST1_PLUGINS_UGLY=y
BR2_PACKAGE_BITSTREAM_VERA=y
BR2_PACKAGE_EXPLORA_SDK=y
BR2_PACKAGE_FDK_AAC=y
BR2_PACKAGE_TREMOR=y
BR2_PACKAGE_CA_CERTIFICATES=y
BR2_PACKAGE_GRAPHITE2=y
BR2_PACKAGE_LCMS2=y
BR2_PACKAGE_LIBMNG=y
BR2_PACKAGE_WPEFRAMEWORK=y
BR2_PACKAGE_WPEFRAMEWORK_BUILD_TYPE_DEBUG=y
BR2_PACKAGE_WPEFRAMEWORK_PORT="2300"
BR2_PACKAGE_WPEFRAMEWORK_DATA_PATH="/UserApps/metrological/usr/share/WPEFramework"
BR2_PACKAGE_WPEFRAMEWORK_SYSTEM_PATH="/UserApps/metrological/usr/lib/wpeframework/plugins"
BR2_PACKAGE_WPEFRAMEWORK_PROXYSTUB_PATH="/UserApps/metrological/usr/lib/wpeframework/proxystubs"
BR2_PACKAGE_WPEFRAMEWORK_SYSTEM_PREFIX="MCA"
BR2_PACKAGE_WPEFRAMEWORK_CRYPTOGRAPHY=y
# BR2_PACKAGE_WPEFRAMEWORK_CDMI_SOFTWARE_OVERRIDE is not set
BR2_PACKAGE_WPEFRAMEWORK_CDMI_PLAYREADY_MODULE=y
BR2_PACKAGE_WPEFRAMEWORK_CDMI_PLAYREADY_SECURE_STOP_METERING_CERTIFICATE="/UserApps/metrological/root/Netflix/artifacts/MeteringCertificate.bin"
BR2_PACKAGE_WPEFRAMEWORK_CDMI_WIDEVINE_MODULE=y
BR2_PACKAGE_WIDEVINE_VERSION_16=y
BR2_PACKAGE_WPEFRAMEWORK_CDMI_WIDEVINE_DEVICE_CERTIFICATE="/UserApps/metrological/root/OCDM/Widevine/cert.bin"
BR2_PACKAGE_WPEFRAMEWORK_CDMI_WIDEVINE_STORAGE_LOCATION="/UserApps/metrological/root/OCDM/Widevine"
BR2_PACKAGE_WPEFRAMEWORK_COBALT=y
BR2_PACKAGE_WPEFRAMEWORK_COBALT_OPERATOR_NAME="MCA"
BR2_PACKAGE_WPEFRAMEWORK_COMPOSITOR=y
BR2_PACKAGE_WPEFRAMEWORK_COMPOSITOR_OUTOFPROCESS=y
BR2_PACKAGE_WPEFRAMEWORK_COMPOSITOR_RESOLUTION_1080P=y
BR2_PACKAGE_WPEFRAMEWORK_COMPOSITOR_NEXUS_SERVER_EXTERNAL=y
BR2_PACKAGE_WPEFRAMEWORK_DIALSERVER=y
BR2_PACKAGE_WPEFRAMEWORK_DIALSERVER_NAME="ExploraUltra"
BR2_PACKAGE_WPEFRAMEWORK_INPUTSWITCH=y
BR2_PACKAGE_WPEFRAMEWORK_LOCATIONSYNC=y
BR2_PACKAGE_WPEFRAMEWORK_LOCATIONSYNC_URI="http://jsonip.metrological.com/?maf=true"
BR2_PACKAGE_WPEFRAMEWORK_REMOTECONTROL=y
BR2_PACKAGE_WPEFRAMEWORK_TIMESYNC=y
BR2_PACKAGE_WPEFRAMEWORK_TRACECONTROL=y
BR2_PACKAGE_WPEFRAMEWORK_VOLUMECONTROL=y
BR2_PACKAGE_WPEFRAMEWORK_WEBKITBROWSER=y
BR2_PACKAGE_WPEFRAMEWORK_APPS=y
BR2_PACKAGE_WPEFRAMEWORK_UX=y
BR2_PACKAGE_WPEFRAMEWORK_WEBSERVER=y
BR2_PACKAGE_WPEFRAMEWORK_WEBSERVER_PORT="80"
BR2_PACKAGE_WPEFRAMEWORK_PROVISIONING=y
BR2_PACKAGE_WPEFRAMEWORK_PROVISIONING_CLOUD=y
BR2_PACKAGE_WPEFRAMEWORK_PROVISIONING_FILES=y
BR2_PACKAGE_LIBOPENH264=y
BR2_PACKAGE_C_ARES=y
BR2_PACKAGE_LIBCURL=y
BR2_PACKAGE_NGHTTP2=y
BR2_PACKAGE_ORC=y
BR2_PACKAGE_SHARED_MIME_INFO=y
BR2_PACKAGE_DROPBEAR=y
BR2_PACKAGE_GESFTPSERVER=y
BR2_PACKAGE_WPA_SUPPLICANT=y
BR2_PACKAGE_WPA_SUPPLICANT_AP_SUPPORT=y
BR2_PACKAGE_WPA_SUPPLICANT_AUTOSCAN=y
BR2_PACKAGE_WPA_SUPPLICANT_EAP=y
BR2_PACKAGE_WPA_SUPPLICANT_HOTSPOT=y
BR2_PACKAGE_WPA_SUPPLICANT_WPS=y
```

## configs/qemu_x86_ml_defconfig
```kconfig
BR2_x86_pentiumpro=y
BR2_TOOLCHAIN_BUILDROOT_GLIBC=y
BR2_PACKAGE_HOST_LINUX_HEADERS_CUSTOM_4_9=y
BR2_TOOLCHAIN_BUILDROOT_CXX=y
BR2_PACKAGE_HOST_GDB=y
BR2_PACKAGE_HOST_GDB_PYTHON=y
BR2_TARGET_GENERIC_ROOT_PASSWD="root"
BR2_TARGET_GENERIC_GETTY_PORT="tty1"
BR2_SYSTEM_DHCP="eth0"
BR2_LINUX_KERNEL=y
BR2_LINUX_KERNEL_CUSTOM_VERSION=y
BR2_LINUX_KERNEL_CUSTOM_VERSION_VALUE="4.9.6"
BR2_LINUX_KERNEL_USE_CUSTOM_CONFIG=y
BR2_LINUX_KERNEL_CUSTOM_CONFIG_FILE="board/qemu/x86/linux-4.9.config"
BR2_PACKAGE_GDB=y
BR2_PACKAGE_GDB_SERVER=y
BR2_PACKAGE_GDB_DEBUGGER=y
BR2_PACKAGE_STRACE=y
BR2_PACKAGE_PYTHON=y
BR2_PACKAGE_LIBPNG=y
BR2_PACKAGE_WPEFRAMEWORK=y
BR2_PACKAGE_WPEFRAMEWORK_BUILD_TYPE_DEBUG=y
BR2_PACKAGE_WPEFRAMEWORK_VIRTUALINPUT=y
# BR2_PACKAGE_WPEFRAMEWORK_COMPOSITORCLIENT is not set
# BR2_PACKAGE_WPEFRAMEWORK_CDMI is not set
# BR2_PACKAGE_WPEFRAMEWORK_DISPLAYINFO is not set
BR2_PACKAGE_WPEFRAMEWORK_REMOTECONTROL=y
BR2_PACKAGE_WPEFRAMEWORK_RESOURCEMONITOR=y
BR2_PACKAGE_WPEFRAMEWORK_TRACECONTROL=y
BR2_PACKAGE_WPEFRAMEWORK_WEBSERVER=y
BR2_PACKAGE_WPEFRAMEWORK_WEBSHELL=y
BR2_PACKAGE_DROPBEAR=y
BR2_TARGET_ROOTFS_EXT2=y
BR2_TARGET_ROOTFS_EXT2_EXTRA_BLOCKS=20
# BR2_TARGET_ROOTFS_TAR is not set
```

## configs/raspberrypi3_wpe_wayland_v4l2_defconfig
```kconfig
BR2_arm=y
BR2_cortex_a53=y
BR2_ARM_FPU_NEON_VFPV4=y
BR2_CCACHE=y
BR2_OPTIMIZE_2=y
BR2_TOOLCHAIN_BUILDROOT_GLIBC=y
BR2_PACKAGE_HOST_LINUX_HEADERS_CUSTOM_4_19=y
BR2_BINUTILS_EXTRA_CONFIG_OPTIONS="--enable-plugins --enable-gold"
BR2_TOOLCHAIN_BUILDROOT_CXX=y
BR2_ROOTFS_DEVICE_CREATION_DYNAMIC_EUDEV=y
BR2_TARGET_GENERIC_ROOT_PASSWD="root"
BR2_SYSTEM_DHCP="eth0"
BR2_ENABLE_LOCALE_WHITELIST="C en_GB"
BR2_ROOTFS_POST_BUILD_SCRIPT="board/raspberrypi3/post-build.sh"
BR2_ROOTFS_POST_IMAGE_SCRIPT="board/raspberrypi3/post-image.sh"
BR2_ROOTFS_POST_SCRIPT_ARGS="--add-pi3-miniuart-bt-overlay"
BR2_LINUX_KERNEL=y
BR2_LINUX_KERNEL_CUSTOM_TARBALL=y
BR2_LINUX_KERNEL_CUSTOM_TARBALL_LOCATION="$(call github,raspberrypi,linux,5eeff139ea9135db6e01a58ef613338f1d0899d8)/linux-5eeff139ea9135db6e01a58ef613338f1d0899d8.tar.gz"
BR2_LINUX_KERNEL_DEFCONFIG="bcm2709"
BR2_LINUX_KERNEL_DTS_SUPPORT=y
BR2_LINUX_KERNEL_INTREE_DTS_NAME="bcm2710-rpi-3-b bcm2710-rpi-3-b-plus bcm2710-rpi-cm3"
BR2_LINUX_KERNEL_NEEDS_HOST_OPENSSL=y
BR2_PACKAGE_GST1_PLUGINS_BASE_PLUGIN_GIO=y
BR2_PACKAGE_GST1_PLUGINS_BASE_LIB_OPENGL=y
BR2_PACKAGE_GST1_PLUGINS_BASE_PLUGIN_OPUS=y
BR2_PACKAGE_GST1_PLUGINS_BAYER2RGB_NEON=y
BR2_PACKAGE_GST1_PLUGINS_GOOD_PLUGIN_AUDIOFX=y
BR2_PACKAGE_GST1_PLUGINS_GOOD_PLUGIN_AUDIOPARSERS=y
BR2_PACKAGE_GST1_PLUGINS_GOOD_PLUGIN_AUTODETECT=y
BR2_PACKAGE_GST1_PLUGINS_GOOD_PLUGIN_DEINTERLACE=y
BR2_PACKAGE_GST1_PLUGINS_GOOD_PLUGIN_ICYDEMUX=y
BR2_PACKAGE_GST1_PLUGINS_GOOD_PLUGIN_ID3DEMUX=y
BR2_PACKAGE_GST1_PLUGINS_GOOD_PLUGIN_INTERLEAVE=y
BR2_PACKAGE_GST1_PLUGINS_GOOD_PLUGIN_MPG123=y
BR2_PACKAGE_GST1_PLUGINS_GOOD_PLUGIN_V4L2=y
BR2_PACKAGE_GST1_PLUGINS_GOOD_PLUGIN_V4L2_PROBE=y
BR2_PACKAGE_GST1_PLUGINS_GOOD_PLUGIN_SOUPHTTPSRC=y
BR2_PACKAGE_GST1_PLUGINS_BAD_PLUGIN_DEBUGUTILS=y
BR2_PACKAGE_GST1_PLUGINS_BAD_PLUGIN_VIDEOPARSERS=y
BR2_PACKAGE_GST1_PLUGINS_BAD_PLUGIN_DASH=y
BR2_PACKAGE_GST1_PLUGINS_BAD_PLUGIN_FAAD=y
BR2_PACKAGE_GST1_PLUGINS_BAD_PLUGIN_HLS=y
BR2_PACKAGE_GST1_PLUGINS_BAD_PLUGIN_KMS=y
BR2_PACKAGE_GST1_PLUGINS_BAD_PLUGIN_OPUS=y
BR2_PACKAGE_BITSTREAM_VERA=y
BR2_PACKAGE_COG=y
BR2_PACKAGE_MESA3D=y
BR2_PACKAGE_MESA3D_GALLIUM_DRIVER_VC4=y
BR2_PACKAGE_MESA3D_OPENGL_ES=y
BR2_PACKAGE_WESTON=y
BR2_PACKAGE_WESTON_DRM=y
BR2_PACKAGE_RPI_FIRMWARE=y
BR2_PACKAGE_OPENJPEG=y
BR2_PACKAGE_WPEWEBKIT=y
BR2_PACKAGE_WPEWEBKIT_MULTIMEDIA=y
BR2_PACKAGE_GLIB_NETWORKING=y
BR2_PACKAGE_DROPBEAR=y
BR2_PACKAGE_DROPBEAR_DISABLE_REVERSEDNS=y
BR2_PACKAGE_HOST_DOSFSTOOLS=y
BR2_PACKAGE_HOST_E2FSPROGS=y
BR2_PACKAGE_HOST_GENIMAGE=y
BR2_PACKAGE_HOST_MTOOLS=y
```

## package/benchflix/Config.in
```kconfig
config BR2_PACKAGE_BENCHFLIX
    bool benchflix
    default n
    help
        Environment for playback related stress tests.

if BR2_PACKAGE_BENCHFLIX

menu "Extra options"

config BR2_PACKAGE_BENCHFLIX_PREBUILT_OPENH264
    bool "Use pre-built libopenh264"
    default y

config BR2_PACKAGE_BENCHFLIX_PREBUILT_FDK_AAC
    bool "Use pre-built fdk-aac"
    default y

config BR2_PACKAGE_BENCHFLIX_SCENER
    bool "Scener"
    default n

config BR2_PACKAGE_BENCHFLIX_CONFLIX
    bool "Conflix"
    default n

choice
	bool "Log level"
	default BR2_PACKAGE_BENCHFLIX_LOG_LEVEL_1
	help
	  Choose benchflix log level
	  
config BR2_PACKAGE_BENCHFLIX_LOG_LEVEL_1
	bool "1 - Error"

config BR2_PACKAGE_BENCHFLIX_LOG_LEVEL_2
	bool "2 - Error & Info"

config BR2_PACKAGE_BENCHFLIX_LOG_LEVEL_3
	bool "3 - Error, Info & Debug"

config BR2_PACKAGE_BENCHFLIX_LOG_LEVEL_4
	bool "4 - Error, Info, Debug & Warn"

endchoice

config BR2_PACKAGE_BENCHFLIX_GL_DEBUG
    bool "GL Debug"
    default n

choice
	bool "DPI"
	default BR2_PACKAGE_BENCHFLIX_DPI_GSTREAMER
	help
	  Choose benchflix log level
	  
config BR2_PACKAGE_BENCHFLIX_DPI_DESKTOP
	bool "Desktop"

config BR2_PACKAGE_BENCHFLIX_DPI_SAMPLE1
	bool "Sample1"

config BR2_PACKAGE_BENCHFLIX_DPI_SAMPLE2
	bool "Sample2"

config BR2_PACKAGE_BENCHFLIX_DPI_GSTREAMER
	bool "Gstreamer"

endchoice

if BR2_PACKAGE_BENCHFLIX_DPI_GSTREAMER

choice
    bool "Gstreamer platform"
    default BR2_PACKAGE_BENCHFLIX_DPI_GSTREAMER_PLATFORM_GENERIC

    config BR2_PACKAGE_BENCHFLIX_DPI_GSTREAMER_PLATFORM_GENERIC
        bool "generic"

    config BR2_PACKAGE_BENCHFLIX_DPI_GSTREAMER_PLATFORM_BCM
        bool "broadcom"

endchoice
endif

endmenu

endif
```

## package/crun/Config.in
```kconfig
config BR2_PACKAGE_CRUN
        bool "crun"
	select BR2_PACKAGE_YAJL
	select BR2_PACKAGE_LIBSECCOMP
        help
          This package installs the 'crun' utility, which is a faster 
	  runc reimplementation
```

## package/disney/Config.in
```kconfig
config BR2_PACKAGE_DISNEY
    bool "disney-adk"
    help
        Disney+ development kit

if BR2_PACKAGE_DISNEY
menu "Extra options"

choice
    bool "Build type"
    default BR2_PACKAGE_DISNEY_BUILD_DEBUG
config BR2_PACKAGE_DISNEY_BUILD_DEBUG
    bool "Debug"
config BR2_PACKAGE_DISNEY_BUILD_RELEASE
    bool "Release"
config BR2_PACKAGE_DISNEY_BUILD_PRODUCTION
    bool "Production"
endchoice

choice
    bool "Build target"
    default BR2_PACKAGE_DISNEY_TARGET_WPE
config BR2_PACKAGE_DISNEY_TARGET_WPE
    bool "WPE"
endchoice

config BR2_PACKAGE_DISNEY_VERBOSE
    bool "Verbose output"
    default n

config BR2_PACKAGE_DISNEY_LINK_LIBRARY
    bool "Build M5 library"
    default y
    help
        Disney+ M5 shared library

config BR2_PACKAGE_DISNEY_LINK_EXECUTABLE
    bool "Build Merlin executable"
    default n
    help
        Disney+ Merlin executable

config BR2_PACKAGE_DISNEY_LINK_TESTS
    bool "Build ADK test suite"
    default n
    help
        Disney+ tests

endmenu
endif
```

## package/disney/disney-libopenssl/Config.in
```kconfig
config BR2_PACKAGE_DISNEY_LIBOPENSSL
    bool "disney-libopenssl"
    help
        OpenSSL for Disney+
```

## package/disney/disney-uma/Config.in
```kconfig
config BR2_PACKAGE_DISNEY_UMA
    bool "disney-uma"
    help
        Disney+ UMA player
```

## package/netflix50/Config.in
```kconfig
config BR2_PACKAGE_NETFLIX50
	bool "Netflix 5.0"
    select BR2_PACKAGE_C_ARES
	select BR2_PACKAGE_EXPAT
	select BR2_PACKAGE_FREETYPE
	select BR2_PACKAGE_HARFBUZZ
	select BR2_PACKAGE_ICU
	select BR2_PACKAGE_JPEG
	select BR2_PACKAGE_LIBCURL
	select BR2_PACKAGE_LIBMNG
    select BR2_PACKAGE_LIBNL
	select BR2_PACKAGE_LIBPNG
	select BR2_PACKAGE_NGHTTP2
	select BR2_PACKAGE_OPENSSL
	select BR2_PACKAGE_WEBP
    select BR2_PACKAGE_ZLIB
    select BR2_PACKAGE_GSTREAMER1
    select BR2_PACKAGE_GST1_PLUGINS_BASE
    select BR2_PACKAGE_GST1_PLUGINS_BAD
    select BR2_PACKAGE_GST1_LIBAV
	help
		Netflix (NRDP)

if BR2_PACKAGE_NETFLIX50

menu "Extra options"

choice
	bool "Netflix Version"
	default BR2_PACKAGE_NETFLIX50_5
	help
        Choose Netflix (NRDP) version

config BR2_PACKAGE_NETFLIX50_5
	bool "5.0.5"
	help
        Netflix NRDP 5.0.5

config BR2_PACKAGE_NETFLIX50_6
	bool "5.0.6"
	help
        Netflix NRDP 5.0.6

endchoice

choice
	bool "Build Type"
	default BR2_PACKAGE_NETFLIX50_BUILD_RELEASE
	help
        Choose build Type

config BR2_PACKAGE_NETFLIX50_BUILD_ML
	bool "Metrological"
	help
        Build with the original metrological flags

config BR2_PACKAGE_NETFLIX50_BUILD_DEBUG
	bool "Debug"
	help
        Build a debug build with tracing and symbols

config BR2_PACKAGE_NETFLIX50_BUILD_RELEASE_DEBUG
	bool "Release Debug"
	help
        Build a debug build with tracing and symbols and production code on (strict SSL/HTTPS).

config BR2_PACKAGE_NETFLIX50_BUILD_RELEASE
	bool "Release"
	select BR2_PACKAGE_NETFLIX50_MINIFY_JS
	help
        Build a release build without tracing and symbols (e.g. for binary delivery)

endchoice

choice
	bool "Application type"
	default BR2_PACKAGE_NETFLIX50_LIB
	help
        Choose application type.

config BR2_PACKAGE_NETFLIX50_APP
	bool "executable"
	help
        Create Netflix standalone app.

config BR2_PACKAGE_NETFLIX50_LIB
	bool "library"
	help
        Create Netflix library.

endchoice

config BR2_PACKAGE_NETFLIX50_KEYMAP
	string "keymap"
	help
        Install custom keymap

config BR2_PACKAGE_NETFLIX50_AUDIO_MIXER
        bool "audio-mixer"
        select BR2_PACKAGE_TREMOR
		select BR2_PACKAGE_LIBOGG
		select BR2_PACKAGE_LIBVORBIS

if BR2_PACKAGE_NETFLIX50_AUDIO_MIXER

config BR2_PACKAGE_NETFLIX50_AUDIO_MIXER_SOFTWARE
	bool "Audio Mixer"
	help
        Enables the Audio Mixer (UI)

endif

choice
	bool "DRM"
	default BR2_PACKAGE_NETFLIX50_DRM_OCDM
	help
        Choose DRM Type

config BR2_PACKAGE_NETFLIX50_DRM_OCDM
	bool "ocdm"
	depends on BR2_PACKAGE_WPEFRAMEWORK_CDMI
	help
        DRM Ocdm

config BR2_PACKAGE_NETFLIX50_DRM_NONE
	bool "none"
	help
        DRM None - no DRM system

endchoice

config BR2_PACKAGE_NETFLIX50_DISABLE_TOOLS
	bool "Disable tools"
	default y
	help
        Do not build tools for netflix

config BR2_PACKAGE_NETFLIX50_MINIFY_JS
    default y
	bool "Minify JS"
	help
        minify javascript files like boot.js

config BR2_PACKAGE_NETFLIX50_CREATE_BINARY_ML_DELIVERY
	bool "Create delivery package"
	help
        Create tarball containing the build to be deployed else where.

endmenu
endif
```

## package/sdk-rdkva-sagemcom/Config.in
```kconfig
config BR2_PACKAGE_SDK_RDKVA_SAGEMCOM
	bool "sdk-rdkva-sagemcom"
	depends on BR2_arm
	select BR2_PACKAGE_HAS_NEXUS_SAGE
	select BR2_PACKAGE_HAS_NEXUS
	select BR2_PACKAGE_HAS_LIBEGL
	select BR2_PACKAGE_HAS_LIBGLES
	select BR2_PACKAGE_HAS_PLAYREADY
	select BR2_PACKAGE_HAS_WAYLAND_EGL
	help
	  Pre-compiled binaries for a platform

if BR2_PACKAGE_SDK_RDKVA_SAGEMCOM

config BR2_PACKAGE_PROVIDES_NEXUS
	default "sdk-rdkva-sagemcom"

config BR2_PACKAGE_PROVIDES_LIBEGL
	default "sdk-rdkva-sagemcom"

config BR2_PACKAGE_PROVIDES_LIBGLES
	default "sdk-rdkva-sagemcom"

config BR2_PACKAGE_PROVIDES_PLAYREADY
	default "sdk-rdkva-sagemcom"

config BR2_PACKAGE_PROVIDES_NEXUS_SAGE
	default "sdk-rdkva-sagemcom"

config BR2_PACKAGE_HAS_WAYLAND_EGL
	bool
endif
```

## package/wpe/wpeframework-avs/Config.in
```kconfig
menuconfig BR2_PACKAGE_WPEFRAMEWORK_AVS
    bool "AVS"
    select BR2_PACKAGE_AVS_DEVICE_SDK
    select BR2_PACKAGE_AVS_DEVICE_SDK_BUILD_GST_MEDIA_PLAYER
    help
        Thunder Alexa Voice Service Plugin
```
